VERSION "HIPBNYYYYYYYYYYYYYYYYYYYYYYYYYYYYYYYYYYYYY/4/%%%/4/'%**4YYY///"

NS_ :

BS_:

BU_:

BO_ 1180 NewMessage0: 8 Vector__XXX
 SG_ Engine1_Stop_Request : 55|8@0+ (1,0) [0|0] "" Vector__XXX
 SG_ Engine2_Stop_Request : 55|8@0+ (1,0) [0|0] "" Vector__XXX
 SG_ Engine3_Stop_Request : 55|8@0+ (1,0) [0|0] "" Vector__XXX

BO_ 968 NewMessage1: 8 Vector__XXX
 SG_ Engine1_RPM : 23|16@0+ (1,0) [0|0] "" Vector__XXX
 SG_ Engine2_RPM : 23|16@0+ (1,0) [0|0] "" Vector__XXX

BO_ 840 NewMessage2: 8 Vector__XXX
 SG_ MG1RPM : 23|16@0+ (1,0) [0|0] "" Vector__XXX
 SG_ MG2RPM : 23|16@0+ (1,0) [0|0] "" Vector__XXX

BO_ 583 NewMessage3: 7 Vector__XXX
 SG_ Target_Engine1_RPM : 47|16@0+ (1,0) [0|0] "" Vector__XXX
 SG_ Target_Engine2_RPM : 47|16@0+ (1,0) [0|0] "" Vector__XXX
